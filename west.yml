## west.yml
```yaml
manifest:
  remotes:
    - name: cdc-mkb 
      url-base: https://github.com/cdc-mkb/zmk.git
  projects:
    - name: zmk
      remote: cdc-mkb
      revision: mouse-pim447
      path: config/boards/shields/1984x/1984x.keymap
      import: app/west.yml
  self:
    path: config
```
